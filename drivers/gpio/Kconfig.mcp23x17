## drivers/gpio/Kconfig.mcp23x17
```kconfig
# MCP23X17 GPIO configuration options

# Copyright (c) 2020 Geanix ApS
# Copyright (c) 2021 Prevas A/S
# SPDX-License-Identifier: Apache-2.0

menuconfig GPIO_MCP23X17
	bool "MCP23017/MCP23S17 GPIO expander chip"
	depends on (SPI || I2C)
	select HAS_DTS_GPIO
	help
	  Enable driver for MCP23017/MCP23S17 GPIO expander chip for either I2C or SPI.

if GPIO_MCP23X17

choice
	prompt "MCP23x17 device select"
	default MCP23X17_DEV_TYPE_I2C
	help
	  Select interface to communicate with MCP23x17 GPIO expander.
	  MCP23017 is using SPI interface
	  MCP23S17 is using I2C interface.

config MCP23X17_DEV_TYPE_SPI
	depends on SPI
	bool "SPI"
config MCP23X17_DEV_TYPE_I2C
	depends on I2C
	bool "I2C"

endchoice

config GPIO_MCP23X17_INIT_PRIORITY
	int "Init priority"
	default 75
	help
	  Device driver initialization priority.

endif #GPIO_MCP23X17
```

## dts/bindings/gpio/microchip,mcp23017.yaml
```yaml
#
# Copyright (c) 2018-2020 Prevas A/S
# Copyright (c) 2021 Dimitris Zervas
#
# SPDX-License-Identifier: Apache-2.0
#

description: Microchip MCP23017 I2C Gpio Expander.

compatible: "microchip,mcp23017"

include: [gpio-controller.yaml, i2c-device.yaml, "microchip,mcp23x17-common.yaml"]
```

## dts/bindings/gpio/microchip,mcp23s17.yaml
```yaml
#
# Copyright (c) 2020 Geanix ApS
# Copyright (c) 2021 Dimitris Zervas
#
# SPDX-License-Identifier: Apache-2.0
#

description: >
    This is a representation of the Microchip MCP23S17 SPI Gpio Expander.

compatible: "microchip,mcp23s17"

include: [gpio-controller.yaml, spi-device.yaml, "microchip,mcp23x17-common.yaml"]
```
